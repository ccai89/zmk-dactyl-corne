/*
 * Copyright (c) 2020 The ZMK Contributors
 *
 * SPDX-License-Identifier: MIT
 */

#include "dactyl_corne_common.dtsi"

/ {
    kscan0: kscan {
        compatible = "zmk,kscan-gpio-matrix";
        wakeup-source;
        diode-direction = "col2row";
        row-gpios
            = <&pro_micro 16 (GPIO_ACTIVE_HIGH | GPIO_PULL_DOWN)>
            , <&pro_micro 10 (GPIO_ACTIVE_HIGH | GPIO_PULL_DOWN)>
            , <&pro_micro 8  (GPIO_ACTIVE_HIGH | GPIO_PULL_DOWN)>
            , <&pro_micro 9  (GPIO_ACTIVE_HIGH | GPIO_PULL_DOWN)>
            ;
    };
    default_layout: default_layout {
        compatible = "zmk,physical-layout";
        display-name = "Default";
        
        transform = <&default_transform>;
        kscan = <&kscan0>;
        
        // Corrected the DTS syntax: used '=' only once, then ',' for continuation.
        keys
            , <&key_physical_attrs 100 100 100  0 0 0 0>
            , <&key_physical_attrs 100 100 200  0 0 0 0>
            , <&key_physical_attrs 100 100 300  0 0 0 0>
            , <&key_physical_attrs 100 100 400  0 0 0 0>
            , <&key_physical_attrs 100 100 500  0 0 0 0>
            , <&key_physical_attrs 100 100 1000 0 0 0 0>
            , <&key_physical_attrs 100 100 1100 0 0 0 0>
            , <&key_physical_attrs 100 100 1200 0 0 0 0>
            , <&key_physical_attrs 100 100 1300 0 0 0 0>
            , <&key_physical_attrs 100 100 1400 0 0 0 0>

            , <&key_physical_attrs 100 100 100  100 0 0 0>
            , <&key_physical_attrs 100 100 200  100 0 0 0>
            , <&key_physical_attrs 100 100 300  100 0 0 0>
            , <&key_physical_attrs 100 100 400  100 0 0 0>
            , <&key_physical_attrs 100 100 500  100 0 0 0>
            , <&key_physical_attrs 100 100 1000 100 0 0 0>
            , <&key_physical_attrs 100 100 1100 100 0 0 0>
            , <&key_physical_attrs 100 100 1200 100 0 0 0>
            , <&key_physical_attrs 100 100 1300 100 0 0 0>
            , <&key_physical_attrs 100 100 1400 100 0 0 0>

            , <&key_physical_attrs 100 100 100  200 0 0 0>
            , <&key_physical_attrs 100 100 200  200 0 0 0>
            , <&key_physical_attrs 100 100 300  200 0 0 0>
            , <&key_physical_attrs 100 100 400  200 0 0 0>
            , <&key_physical_attrs 100 100 500  200 0 0 0>            
            , <&key_physical_attrs 100 100 1000 200 0 0 0>
            , <&key_physical_attrs 100 100 1100 200 0 0 0>
            , <&key_physical_attrs 100 100 1200 200 0 0 0>
            , <&key_physical_attrs 100 100 1300 200 0 0 0>
            , <&key_physical_attrs 100 100 1400 200 0 0 0>

            , <&key_physical_attrs 100 100 400  300 0 0 0>
            , <&key_physical_attrs 100 100 500  300 0 0 0>
            , <&key_physical_attrs 100 100 600  300 0 0 0>
            , <&key_physical_attrs 100 100 900  300 0 0 0>
            , <&key_physical_attrs 100 100 1000 300 0 0 0>            
            , <&key_physical_attrs 100 100 1100 300 0 0 0>
            ;
    };
};